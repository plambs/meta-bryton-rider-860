## conf/layer.conf
```bitbake
# We have a conf and classes directory, add to BBPATH
BBPATH .= ":${LAYERDIR}"

# We have recipes-* directories, add to BBFILES
BBFILES += "${LAYERDIR}/recipes-*/*/*.bb \
            ${LAYERDIR}/recipes-*/*/*.bbappend"

BBFILE_COLLECTIONS += "meta-bryton-rider-860"
BBFILE_PATTERN_meta-bryton-rider-860 = "^${LAYERDIR}/"
BBFILE_PRIORITY_meta-bryton-rider-860 = "6"

LAYERDEPENDS_meta-bryton-rider-860 = "core"
LAYERSERIES_COMPAT_meta-bryton-rider-860 = "kirkstone"
```

## conf/machine/bryton-rider-860.conf
```bitbake
#@TYPE: Machine
#@NAME: Bryton Rider 860
#@DESCRIPTION: Machine configuration for the Bryton Rider 860

require conf/machine/include/arm/armv7a/tune-cortexa7.inc
DEFAULTTUNE = "cortexa7hf-neon-vfpv4"

SERIAL_CONSOLES ?= "115200;ttyS0"
IMAGE_FSTYPES ?= "tar.bz2 ext4"

#MACHINE_EXTRA_RRECOMMENDS = "kernel-modules kernel-devicetree"
MACHINE_EXTRA_RRECOMMENDS = "kernel-modules"

EXTRA_IMAGEDEPENDS += "virtual/bootloader"
PREFERRED_PROVIDER_virtual/bootloader = "u-boot-bryton"
PREFERRED_PROVIDER_virtual/kernel = "linux-bryton"

KERNEL_IMAGETYPE = "zImage"
KERNEL_BOOTCMD = "bootz"
IMAGE_BOOT_FILES = "u-boot.${UBOOT_SUFFIX}"

SPL_BINARY = "u-boot-sunxi-with-spl.${UBOOT_SUFFIX}"
UBOOT_SUFFIX = "bin"
UBOOT_MACHINE = "A33-bryton860_defconfig"
UBOOT_ENTRYPOINT = "0x42000000"
UBOOT_LOADADDRESS = "0x42000000"

## When u-boot is enabled we need to use the "Image" format and the "booti"
## command to load the kernel
#KERNEL_IMAGETYPE_UBOOT ?= "Image"
## "zImage" not supported on arm64 and ".gz" images not supported by bootloader yet
#KERNEL_IMAGETYPE_DIRECT ?= "Image"
#KERNEL_BOOTCMD ?= "booti"
KBUILD_DEFCONFIG = "sunxi_defconfig"
```
